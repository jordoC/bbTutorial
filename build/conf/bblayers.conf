## build/conf/bblayers.conf
```bitbake
BBPATH     := "${TOPDIR}"
TMPDIR      = "${TOPDIR}/tmp"
BBFILES    ?= ""
BBLAYERS    = "${TOPDIR}/../meta-tutorial"
PN          = "${@bb.parse.vars_from_file(d.getVar('FILE', False),d)[0] or 'defaultpkgname'}"
CACHE       = "${TMPDIR}/cache/default"
STAMP       = "${TMPDIR}/${PN}/stamps"
T           = "${TMPDIR}/${PN}/work"
B           = "${TMPDIR}/${PN}"
```
